

TDSL_DATA_TYPE_DECL(NULLTYPE      , 0x1)  TDSL_DATA_TYPE_LIST_DELIM
TDSL_DATA_TYPE_DECL(INT1TYPE      , 0x30) TDSL_DATA_TYPE_LIST_DELIM
TDSL_DATA_TYPE_DECL(BITTYPE       , 0x32) TDSL_DATA_TYPE_LIST_DELIM
TDSL_DATA_TYPE_DECL(INT2TYPE      , 0x34) TDSL_DATA_TYPE_LIST_DELIM
TDSL_DATA_TYPE_DECL(INT4TYPE      , 0x38) TDSL_DATA_TYPE_LIST_DELIM
TDSL_DATA_TYPE_DECL(DATETIM4TYPE  , 0x3A) TDSL_DATA_TYPE_LIST_DELIM
TDSL_DATA_TYPE_DECL(FLT4TYPE      , 0x3B) TDSL_DATA_TYPE_LIST_DELIM
TDSL_DATA_TYPE_DECL(MONEYTYPE     , 0x3C) TDSL_DATA_TYPE_LIST_DELIM
TDSL_DATA_TYPE_DECL(DATETIMETYPE  , 0x3D) TDSL_DATA_TYPE_LIST_DELIM
TDSL_DATA_TYPE_DECL(FLT8TYPE      , 0x3E) TDSL_DATA_TYPE_LIST_DELIM
TDSL_DATA_TYPE_DECL(MONEY4TYPE    , 0x7A) TDSL_DATA_TYPE_LIST_DELIM
TDSL_DATA_TYPE_DECL(INT8TYPE      , 0x7F) TDSL_DATA_TYPE_LIST_DELIM
TDSL_DATA_TYPE_DECL(GUIDTYPE      , 0x24) TDSL_DATA_TYPE_LIST_DELIM
TDSL_DATA_TYPE_DECL(INTNTYPE      , 0x26) TDSL_DATA_TYPE_LIST_DELIM
TDSL_DATA_TYPE_DECL(DECIMALTYPE   , 0x37) TDSL_DATA_TYPE_LIST_DELIM
TDSL_DATA_TYPE_DECL(NUMERICTYPE   , 0x3F) TDSL_DATA_TYPE_LIST_DELIM
TDSL_DATA_TYPE_DECL(BITNTYPE      , 0x68) TDSL_DATA_TYPE_LIST_DELIM
TDSL_DATA_TYPE_DECL(DECIMALNTYPE  , 0x6A) TDSL_DATA_TYPE_LIST_DELIM
TDSL_DATA_TYPE_DECL(NUMERICNTYPE  , 0x6C) TDSL_DATA_TYPE_LIST_DELIM
TDSL_DATA_TYPE_DECL(FLTNTYPE      , 0x6D) TDSL_DATA_TYPE_LIST_DELIM
TDSL_DATA_TYPE_DECL(MONEYNTYPE    , 0x6E) TDSL_DATA_TYPE_LIST_DELIM
TDSL_DATA_TYPE_DECL(DATETIMNTYPE  , 0x6F) TDSL_DATA_TYPE_LIST_DELIM
TDSL_DATA_TYPE_DECL(BIGVARBINTYPE , 0xA5) TDSL_DATA_TYPE_LIST_DELIM
TDSL_DATA_TYPE_DECL(BIGVARCHRTYPE , 0xA7) TDSL_DATA_TYPE_LIST_DELIM
TDSL_DATA_TYPE_DECL(BIGBINARYTYPE , 0xAD) TDSL_DATA_TYPE_LIST_DELIM
TDSL_DATA_TYPE_DECL(BIGCHARTYPE   , 0xAF) TDSL_DATA_TYPE_LIST_DELIM
TDSL_DATA_TYPE_DECL(NVARCHARTYPE  , 0xE7) TDSL_DATA_TYPE_LIST_DELIM
TDSL_DATA_TYPE_DECL(NCHARTYPE     , 0xEF) TDSL_DATA_TYPE_LIST_DELIM
TDSL_DATA_TYPE_DECL(TEXTTYPE      , 0x23) TDSL_DATA_TYPE_LIST_DELIM
TDSL_DATA_TYPE_DECL(IMAGETYPE     , 0x22) TDSL_DATA_TYPE_LIST_DELIM
TDSL_DATA_TYPE_DECL(NTEXTTYPE     , 0x63)

// Auto-undef
#undef TDSL_DATA_TYPE_DECL
#undef TDSL_DATA_TYPE_LIST_DELIM
